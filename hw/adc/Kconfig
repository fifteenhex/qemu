## hw/m68k/Kconfig
```kconfig
config APOLLO
    bool
    default y
    depends on M68K
    select ISA_BUS
    select I8259
    select MC146818RTC
    select SCN2681

config AN5206
    bool
    default y
    depends on M68K
    select COLDFIRE
    select PTIMER

config MCF5208
    bool
    default y
    depends on M68K
    select COLDFIRE
    select PTIMER

config NEXTCUBE
    bool
    default y
    depends on M68K
    select FRAMEBUFFER
    select ESCC
    select EMPTY_SLOT

config Q800
    bool
    default y
    depends on M68K
    select MAC_VIA
    select NUBUS
    select MACFB
    select RADIUS24XP
    select NUBUS_MAC8390
    select SWIM
    select ESCC
    select ESP
    select DP8393X
    select OR_IRQ
    select DJMEMC
    select IOSB
    select ASC

config QUADRA700
    bool
    default y
    depends on M68K
    # IRQ glue comes from q800-glue.c (CONFIG_Q800, always on here)
    select MAC_VIA
    select NUBUS
    select MACFB
    select SWIM
    select ESCC
    select ESP
    select DP8393X
    select OR_IRQ
    select ASC

config QUADRA950
    bool
    default y
    depends on M68K
    # IRQ glue comes from q800-glue.c (CONFIG_Q800, always on here)
    select ADB
    select MOS6522
    select MAC_VIA
    select NUBUS
    select MACFB
    select SWIM
    select ESCC
    select ESP
    select DP8393X
    select OR_IRQ
    select ASC

config LC475
    bool
    default y
    depends on M68K
    # IRQ glue comes from q800-glue.c (CONFIG_Q800, always on here)
    select ADB
    select MOS6522
    select MAC_VIA
    select ESCC
    select ESP
    select SWIM
    select ASC
    select OR_IRQ
    select FRAMEBUFFER

config QUADRA630
    bool
    default y
    depends on M68K
    # IRQ glue comes from q800-glue.c (CONFIG_Q800, always on here)
    select ADB
    select MOS6522
    select MAC_VIA
    select ESCC
    select ESP
    select SWIM
    select ASC
    select OR_IRQ
    select FRAMEBUFFER
    select IDE_MMIO

config MAC128K
    bool
    default y
    depends on M68K
    select MOS6522
    select ESCC
    select IWM
    select NCR5380
    select OR_IRQ
    select FRAMEBUFFER

config MACIISI
    bool
    default y
    depends on M68K
    select ADB
    select MOS6522
    select ESCC
    select SWIM
    select ASC
    select OR_IRQ
    select FRAMEBUFFER
    select NCR5380
    select NUBUS
    select NUBUS_MAC8390

config MACIICI
    bool
    default y
    depends on M68K
    select ADB
    select MOS6522
    select ESCC
    select SWIM
    select ASC
    select OR_IRQ
    select FRAMEBUFFER
    select NCR5380
    select NUBUS
    select NUBUS_MAC8390

config MACCLASSICII
    bool
    default y
    depends on M68K
    select ADB
    select MOS6522
    select ESCC
    select SWIM
    select ASC
    select OR_IRQ
    select FRAMEBUFFER
    select NCR5380

config MACSE30
    bool
    default y
    depends on M68K
    select ADB
    select MOS6522
    select ESCC
    select SWIM
    select ASC
    select OR_IRQ
    select FRAMEBUFFER
    select NCR5380

config M68K_VIRT
    bool
    default y
    depends on M68K
    select M68K_IRQC
    select VIRT_CTRL
    select GOLDFISH_PIC
    select GOLDFISH_TTY
    select GOLDFISH_RTC
    select VIRTIO_MMIO

config MC68EZ328
    bool
    default y
    depends on M68K
    select M68K_IRQC
    select DRAGONBALL_PLL
    select DRAGONBALL_GPIO
    select DRAGONBALL_INTC
    select DRAGONBALL_UART
    select DRAGONBALL_TIMER
    select DRAGONBALL_SPI
    select SSI_SD
    select DRAGONBALL_LCDC
    select DRAGONBALL_RTC
    select DS1305

config PALM
    bool
    default y
    depends on M68K
    select M68K_IRQC
    select DRAGONBALL_PLL
    select DRAGONBALL_SCR
    select DRAGONBALL_GPIO
    select DRAGONBALL_INTC
    select DRAGONBALL_UART
    select DRAGONBALL_TIMER
    select DRAGONBALL_SPI
    select DRAGONBALL_SPI1
    select DRAGONBALL_LCDC
    select DRAGONBALL_RTC
    select SED1376
    select CLIE_LCD
    select ADS7843
    select PALM_KEYPAD
    select DRAGONBALL_PWM
    select SPLIT_IRQ
    select SSI_SD
    select SD
    select SONY_MSHC_STUB
    select DRAGONBALL_SZ

config SUN3
    bool
    default y
    depends on M68K
    select ESCC
    select ICM7170

config MVME147
    bool
    default y
    depends on M68K
    select M68K_IRQC
    select MVME147_PCC
    select MVME147_VMECHIP
    select ESCC
    select M48T59
    select LANCE
    select WD33C93
    select VME
    select AVME352

config ELTEC_E17
    bool
    default y
    depends on M68K
    select E17_SYSC
    select E17_VID
    select CD2401
    select LANCE
    select NCR53C720
    select M48T59

config AMIGA
    bool
    default y
    depends on M68K
    select PTIMER
    select SPLIT_IRQ
    select OR_IRQ
    select PCNET_COMMON
    select WD33C93
    select IDE_GAYLE
    select BITBANG_I2C
    select AT24C
    select PCI
    imply PCI_DEVICES
    # device-tree direct boot of an MMU-less 68000 kernel (a500): a
    # goldfish console the DT kernel's drivers bind to, and libfdt to
    # synthesise the blob handed over in d7.
    select GOLDFISH_TTY
    select DEVICE_TREE

config ATARIST
    bool
    default y
    depends on M68K
    select FRAMEBUFFER

config MEGADRIVE
    bool
    default y
    depends on M68K
    select M68K_IRQC
    select MEGADRIVE_VDP
    select MEGADRIVE_EVERDRIVE

config AVME352
    bool
    default y
    depends on M68K
    select ESCC
    select VME

config SORD_M68MX
    bool
    default y
    depends on M68K
```
